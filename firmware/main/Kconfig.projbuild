## firmware/main/Kconfig.projbuild
```kconfig
menu "Naari cellular transport"
config NAARI_A7672S_ENABLED
    bool "Use direct A7672S LTE modem instead of Android for SMS/calls/location"
    default y
    help
        BLE remains available for pairing and persisted guardian configuration.
        No automatic failover or retry after an uncertain cellular submission.
config NAARI_MODEM_TX_GPIO
    int "ESP32 TX GPIO (connect to modem RX)"
    range 0 48
    default 43
    depends on NAARI_A7672S_ENABLED
config NAARI_MODEM_RX_GPIO
    int "ESP32 RX GPIO (connect to modem TX)"
    range 0 48
    default 44
    depends on NAARI_A7672S_ENABLED
config NAARI_MODEM_BAUD
    int "Modem UART baud"
    range 9600 921600
    default 115200
    depends on NAARI_A7672S_ENABLED
endmenu
```

## firmware/sdkconfig.defaults
```kconfig
# Target Configuration
CONFIG_IDF_TARGET="esp32s3"
CONFIG_IDF_TARGET_ESP32S3=y

# CPU & Memory
CONFIG_ESP32S3_DEFAULT_CPU_FREQ_240=y
CONFIG_ESP32S3_DEFAULT_CPU_FREQ_MHZ=240
CONFIG_SPIRAM=y
CONFIG_SPIRAM_MODE_OCT=y
CONFIG_SPIRAM_TYPE_AUTO=y
CONFIG_SPIRAM_SIZE=8388608
CONFIG_SPIRAM_SPEED_80M=y
CONFIG_SPIRAM_BOOT_INIT=y
CONFIG_SPIRAM_USE_MALLOC=y
CONFIG_SPIRAM_MEMTEST=y

# Flash Configuration (32MB / 16MB)
CONFIG_ESPTOOLPY_FLASHSIZE_16MB=y
CONFIG_ESPTOOLPY_FLASHMODE_OPI=y
CONFIG_ESPTOOLPY_FLASHFREQ_80M=y

# Partition Table
CONFIG_PARTITION_TABLE_CUSTOM=y
CONFIG_PARTITION_TABLE_CUSTOM_FILENAME="partitions.csv"
CONFIG_PARTITION_TABLE_FILENAME="partitions.csv"

# FreeRTOS
CONFIG_FREERTOS_HZ=1000
CONFIG_FREERTOS_UNICORE=n
CONFIG_FREERTOS_ENABLE_BACKWARD_COMPATIBILITY=y
CONFIG_FREERTOS_CHECK_STACKOVERFLOW_CANARY=y

# C++ Configuration
CONFIG_COMPILER_CXX_EXCEPTIONS=n
CONFIG_COMPILER_CXX_RTTI=n

# Power Management & Dynamic Frequency Scaling
CONFIG_PM_ENABLE=y
CONFIG_PM_DFS_INIT_AUTO=y

# Log output & Console
CONFIG_ESP_CONSOLE_USB_SERIAL_JTAG=y
CONFIG_ESP_CONSOLE_SECONDARY_NONE=y
CONFIG_LOG_DEFAULT_LEVEL_INFO=y
CONFIG_LOG_MAXIMUM_LEVEL_VERBOSE=y

# FatFS & VFS
CONFIG_FATFS_SECTOR_512=y
CONFIG_FATFS_LFN_HEAP=y
CONFIG_FATFS_MAX_LFN=255

# Real authenticated BLE phone bridge
CONFIG_BT_ENABLED=y
CONFIG_BT_NIMBLE_ENABLED=y
CONFIG_BT_NIMBLE_ROLE_PERIPHERAL=y
CONFIG_BT_NIMBLE_MAX_CONNECTIONS=1
CONFIG_BT_NIMBLE_MAX_BONDS=1
CONFIG_BT_NIMBLE_NVS_PERSIST=y
CONFIG_BT_NIMBLE_ATT_PREFERRED_MTU=512
CONFIG_BT_NIMBLE_HOST_TASK_STACK_SIZE=6144
CONFIG_BT_NIMBLE_SM_SC=y
CONFIG_CODEC_ES8311_SUPPORT=y
CONFIG_CODEC_ES7210_SUPPORT=y
```
